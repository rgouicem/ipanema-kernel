## kernel/sched/Kconfig.ipanema
```kconfig
config IPANEMA_DEBUG_TOPOLOGY
        def_bool n
	prompt "Print topology during boot"

config IPANEMA_PANIC_ON_BAD_TRANSITION
        def_bool n
	prompt "Panic when a bad transition in the ipanema finite state machine is detected. Use for debug only."

config CGROUP_IPANEMA
       def_bool y
       prompt "Ipanema controller"
       depends on CGROUPS

menu "Ipanema policies"

source "kernel/sched/ipanema/Kconfig"

endmenu
```

## kernel/sched/Kconfig.sched_monitor
```kconfig
config SCHED_MONITOR
        def_bool n
	prompt "Enable scheduler monitoring"
	---help---
	  Scheduler monitoring facility.

config SCHED_MONITOR_CORE
        def_bool n
	prompt "Scheduler subsystem monitoring"
	depends on SCHED_MONITOR
	---help---
	  Monitor the scheduler subsystem, and expose the results through the
	  debugfs interface /sys/kernel/debug/sched_monitor/sched_time

config SCHED_MONITOR_FAIR
        def_bool n
	prompt "Fair scheduling class monitoring"
	depends on SCHED_MONITOR
	---help---
	  Monitor the fair scheduling class, and expose the results through the
	  debugfs interface /sys/kernel/debug/sched_monitor/fair_stats

config SCHED_MONITOR_IPANEMA
        def_bool n
	prompt "Ipanema scheduling class monitoring"
	depends on SCHED_MONITOR
	---help---
	  Monitor the ipanema scheduling class, and expose the results through the
	  debugfs interface /sys/kernel/debug/sched_monitor/ipanema_stats

config SCHED_MONITOR_IDLE
        def_bool n
	prompt "Idle scheduling class monitoring"
	depends on SCHED_MONITOR
	---help---
	  Monitor the idle scheduling class, and expose the results through the
	  debugfs interface /sys/kernel/debug/sched_monitor/idle_stats

config SCHED_MONITOR_TRACER
        def_bool n
	prompt "Event tracer"
	depends on SCHED_MONITOR
	---help---
	Scheduler tracer that provides a per-cpu log in /sys/kernel/debug/sched_monitor/tracer/
	of all scheduling events that happened.

config SCHED_MONITOR_TRACER_BUFFER_SIZE
        int
	default 64
	prompt "Per-cpu buffer size (MiB)"
	depends on SCHED_MONITOR_TRACER
	---help---
	Size of the per-cpu buffer used by the tracer in MiB.

config SCHED_MONITOR_DOMAINS
        def_bool n
	depends on SCHED_MONITOR
	prompt "Print sched domains and groups at scheduler init"
```

## kernel/sched/ipanema/Kconfig
```kconfig
config IPANEMA_POLICY_CFS
        def_tristate n
	prompt "cfs"
	---help---
	CFS-like policy

config IPANEMA_POLICY_CFS_WWC
        def_tristate n
	prompt "cfs_wwc"
	---help---
	CFS-like policy ensuring Weak Work-Conservation

config IPANEMA_POLICY_CFS_WWC_LOCAL_NEW_UNBLOCK
        def_tristate n
	prompt "cfs_wwc_local_new_unblock"
	---help---
	CFS-like policy ensuring Weak Work-Conservation that places threads locally on new and unblock events
```
